VERSION ""

NS_ :

BS_:

BU_: ElmarMPPTA

BO_ 1696 ElmarMPPTA_InputMeasurements: 8 ElmarMPPTA
 SG_ InputVoltage : 0|32@1- (1,0) [0|0] "Volt" Vector__XXX
 SG_ InputCurrent : 32|32@1- (1,0) [0|0] "Ampere" Vector__XXX

BO_ 1697 ElmarMPPTA_OutputMeasurements: 8 ElmarMPPTA
 SG_ OutputVoltae : 0|32@1- (1,0) [0|0] "Volt" Vector__XXX
 SG_ OutputCurrent : 32|32@1- (1,0) [0|0] "Ampere" Vector__XXX

BO_ 1698 ElmarMPPTA_Temperature: 8 ElmarMPPTA
 SG_ MosfetTemperature : 0|32@1- (1,0) [0|0] "°C" Vector__XXX
 SG_ ControllerTemperature : 32|32@1- (1,0) [0|0] "°C" Vector__XXX

BO_ 1699 ElmarMPPTA_AuxiliaryPowerSupply: 8 ElmarMPPTA
 SG_ Pwr12V : 0|32@1- (1,0) [0|0] "Volt" Vector__XXX
 SG_ Pwr3V : 32|32@1- (1,0) [0|0] "Volt" Vector__XXX

BO_ 1700 ElmarMPPTA_Limits: 8 ElmarMPPTA
 SG_ MaxOutputVoltage : 0|32@1- (1,0) [0|0] "Volt" Vector__XXX
 SG_ MaxInputCurrent : 32|32@1- (1,0) [0|0] "Ampere" Vector__XXX

BO_ 1701 ElmarMPPTA_Status: 8 ElmarMPPTA
 SG_ CanRxErrorCnt : 0|8@1+ (1,0) [0|0] "" Vector__XXX
 SG_ CanTxErrorCnt : 8|8@1+ (1,0) [0|0] "" Vector__XXX
 SG_ CanTxOverflowCnt : 16|8@1+ (1,0) [0|0] "" Vector__XXX
 SG_ ErrorFlagLowArrayPower : 24|1@1+ (1,0) [0|0] "" Vector__XXX
 SG_ ErrorFlagMosfetOverheat : 25|1@1+ (1,0) [0|0] "" Vector__XXX
 SG_ ErrorFlagBatteryLow : 26|1@1+ (1,0) [0|0] "" Vector__XXX
 SG_ ErrorFlagBatteryFull : 27|1@1+ (1,0) [0|0] "" Vector__XXX
 SG_ ErrorFlag12VUndervoltage : 28|1@1+ (1,0) [0|0] "" Vector__XXX
 SG_ ErrorFlagReserved : 29|1@1+ (1,0) [0|0] "" Vector__XXX
 SG_ ErrorFlagHwOvercurrent : 30|1@1+ (1,0) [0|0] "" Vector__XXX
 SG_ ErrorFlagHwOvervoltage : 31|1@1+ (1,0) [0|0] "" Vector__XXX
 SG_ LimitFlagsInputCurrentMin : 32|1@1+ (1,0) [0|0] "" Vector__XXX
 SG_ LimitFlagsInputCurrentMax : 33|1@1+ (1,0) [0|0] "" Vector__XXX
 SG_ LimitFlagsOutputVoltageMax : 34|1@1+ (1,0) [0|0] "" Vector__XXX
 SG_ LimitFlagsMosfetTemperature : 35|1@1+ (1,0) [0|0] "" Vector__XXX
 SG_ LimitFlagsDutyCycleMin : 36|1@1+ (1,0) [0|0] "" Vector__XXX
 SG_ LimitFlagsDutyCycleMax : 37|1@1+ (1,0) [0|0] "" Vector__XXX
 SG_ LimitFlagsLocalMPPT : 38|1@1+ (1,0) [0|0] "" Vector__XXX
 SG_ LimitFlagsGlobalMPPT : 39|1@1+ (1,0) [0|0] "" Vector__XXX
 SG_ Mode : 40|1@1+ (1,0) [0|0] "" Vector__XXX
 SG_ TestCounter : 48|8@1+ (1,0) [0|0] "" Vector__XXX

BO_ 1702 ElmarMPPTA_PowerConnector: 8 ElmarMPPTA
 SG_ OutputVoltage : 0|32@1- (1,0) [0|0] "Volt" Vector__XXX
 SG_ PowerConnectorTemperature : 32|32@1- (1,0) [0|0] "°C" Vector__XXX

BO_ 1703 ElmarMPPTA_SweepMeasurements: 8 ElmarMPPTA
 SG_ InputVoltageSweep : 0|32@1- (1,0) [0|0] "Volt" Vector__XXX
 SG_ InputCurrentSweep : 32|32@1- (1,0) [0|0] "Ampere" Vector__XXX

BO_ 1704 ElmarMPPTA_ModeInput: 8 ElmarMPPTA
 SG_ ModeInput : 0|8@1+ (1,0) [0|0] "" Vector__XXX

BO_ 1705 ElmarMPPTA_SweepPeriodInput: 8 ElmarMPPTA
 SG_ SweepPeriodInput : 0|8@1+ (1,0) [0|0] "seconds" Vector__XXX

BO_ 1706 ElmarMPPTA_MaxOutputVoltageInput: 8 ElmarMPPTA
 SG_ MaxOutputVoltageInput : 0|32@1- (1,0) [0|0] "Volt" Vector__XXX

BO_ 1707 ElmarMPPTA_MaxInputCurrentInput: 8 ElmarMPPTA

BO_ 1708 ElmarMPPTA_Reserved1: 8 ElmarMPPTA

BO_ 1709 ElmarMPPTA_Reserved2: 8 ElmarMPPTA

BO_ 1710 ElmarMPPTA_Reserved3: 8 ElmarMPPTA

BO_ 1711 ElmarMPPTA_Reserved4: 8 ElmarMPPTA

CM_ SG_ 1701 Mode "0 = standby, 1 = local tracking";
CM_ SG_ 1701 TestCounter "+1 every second";
CM_ BO_ 1703 "Only during sweeps, 100Hz send rate";
CM_ SG_ 1704 ModeInput "0 = standby, 1 = local tracking";
SIG_VALTYPE_ 1696 InputVoltage : 1;
SIG_VALTYPE_ 1696 InputCurrent : 1;
SIG_VALTYPE_ 1697 OutputVoltae : 1;
SIG_VALTYPE_ 1697 OutputCurrent : 1;
SIG_VALTYPE_ 1698 MosfetTemperature : 1;
SIG_VALTYPE_ 1698 ControllerTemperature : 1;
SIG_VALTYPE_ 1699 Pwr12V : 1;
SIG_VALTYPE_ 1699 Pwr3V : 1;
SIG_VALTYPE_ 1700 MaxOutputVoltage : 1;
SIG_VALTYPE_ 1700 MaxInputCurrent : 1;
SIG_VALTYPE_ 1702 OutputVoltage : 1;
SIG_VALTYPE_ 1702 PowerConnectorTemperature : 1;
SIG_VALTYPE_ 1703 InputVoltageSweep : 1;
SIG_VALTYPE_ 1703 InputCurrentSweep : 1;
SIG_VALTYPE_ 1706 MaxOutputVoltageInput : 1;
