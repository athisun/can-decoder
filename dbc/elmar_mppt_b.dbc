VERSION ""

NS_ :

BS_:

BU_: ElmarMPPTB

BO_ 1712 ElmarMPPTB_InputMeasurements: 8 ElmarMPPTB
 SG_ InputVoltage : 0|32@1- (1,0) [0|0] "Volt" Vector__XXX
 SG_ InputCurrent : 32|32@1- (1,0) [0|0] "Ampere" Vector__XXX

BO_ 1713 ElmarMPPTB_OutputMeasurements: 8 ElmarMPPTB
 SG_ OutputVoltae : 0|32@1- (1,0) [0|0] "Volt" Vector__XXX
 SG_ OutputCurrent : 32|32@1- (1,0) [0|0] "Ampere" Vector__XXX

BO_ 1714 ElmarMPPTB_Temperature: 8 ElmarMPPTB
 SG_ MosfetTemperature : 0|32@1- (1,0) [0|0] "°C" Vector__XXX
 SG_ ControllerTemperature : 32|32@1- (1,0) [0|0] "°C" Vector__XXX

BO_ 1715 ElmarMPPTB_AuxiliaryPowerSupply: 8 ElmarMPPTB
 SG_ Pwr12V : 0|32@1- (1,0) [0|0] "Volt" Vector__XXX
 SG_ Pwr3V : 32|32@1- (1,0) [0|0] "Volt" Vector__XXX

BO_ 1716 ElmarMPPTB_Limits: 8 ElmarMPPTB
 SG_ MaxOutputVoltage : 0|32@1- (1,0) [0|0] "Volt" Vector__XXX
 SG_ MaxInputCurrent : 32|32@1- (1,0) [0|0] "Ampere" Vector__XXX

BO_ 1717 ElmarMPPTB_Status: 8 ElmarMPPTB
 SG_ CanRxErrorCnt : 0|8@1+ (1,0) [0|0] "" Vector__XXX
 SG_ CanTxErrorCnt : 8|8@1+ (1,0) [0|0] "" Vector__XXX
 SG_ CanTxOverflowCnt : 16|8@1+ (1,0) [0|0] "" Vector__XXX
 SG_ ErrorFlagLowArrayPower : 24|1@1+ (1,0) [0|0] "" Vector__XXX
 SG_ ErrorFlagMosfetOverheat : 25|1@1+ (1,0) [0|0] "" Vector__XXX
 SG_ ErrorFlagBatteryLow : 26|1@1+ (1,0) [0|0] "" Vector__XXX
 SG_ ErrorFlagBatteryFull : 27|1@1+ (1,0) [0|0] "" Vector__XXX
 SG_ ErrorFlag12VUndervoltage : 28|1@1+ (1,0) [0|0] "" Vector__XXX
 SG_ ErrorFlagReserved : 29|1@1+ (1,0) [0|0] "" Vector__XXX
 SG_ ErrorFlagHwOvercurrent : 30|1@1+ (1,0) [0|0] "" Vector__XXX
 SG_ ErrorFlagHwOvervoltage : 31|1@1+ (1,0) [0|0] "" Vector__XXX
 SG_ LimitFlagsInputCurrentMin : 32|1@1+ (1,0) [0|0] "" Vector__XXX
 SG_ LimitFlagsInputCurrentMax : 33|1@1+ (1,0) [0|0] "" Vector__XXX
 SG_ LimitFlagsOutputVoltageMax : 34|1@1+ (1,0) [0|0] "" Vector__XXX
 SG_ LimitFlagsMosfetTemperature : 35|1@1+ (1,0) [0|0] "" Vector__XXX
 SG_ LimitFlagsDutyCycleMin : 36|1@1+ (1,0) [0|0] "" Vector__XXX
 SG_ LimitFlagsDutyCycleMax : 37|1@1+ (1,0) [0|0] "" Vector__XXX
 SG_ LimitFlagsLocalMPPT : 38|1@1+ (1,0) [0|0] "" Vector__XXX
 SG_ LimitFlagsGlobalMPPT : 39|1@1+ (1,0) [0|0] "" Vector__XXX
 SG_ Mode : 40|1@1+ (1,0) [0|0] "" Vector__XXX
 SG_ TestCounter : 48|8@1+ (1,0) [0|0] "" Vector__XXX

BO_ 1718 ElmarMPPTB_PowerConnector: 8 ElmarMPPTB
 SG_ OutputVoltage : 0|32@1- (1,0) [0|0] "Volt" Vector__XXX
 SG_ PowerConnectorTemperature : 32|32@1- (1,0) [0|0] "°C" Vector__XXX

BO_ 1719 ElmarMPPTB_SweepMeasurements: 8 ElmarMPPTB
 SG_ InputVoltageSweep : 0|32@1- (1,0) [0|0] "Volt" Vector__XXX
 SG_ InputCurrentSweep : 32|32@1- (1,0) [0|0] "Ampere" Vector__XXX

BO_ 1720 ElmarMPPTB_ModeInput: 8 ElmarMPPTB
 SG_ ModeInput : 0|8@1+ (1,0) [0|0] "" Vector__XXX

BO_ 1721 ElmarMPPTB_SweepPeriodInput: 8 ElmarMPPTB
 SG_ SweepPeriodInput : 0|8@1+ (1,0) [0|0] "seconds" Vector__XXX

BO_ 1722 ElmarMPPTB_MaxOutputVoltageInput: 8 ElmarMPPTB
 SG_ MaxOutputVoltageInput : 0|32@1- (1,0) [0|0] "Volt" Vector__XXX

BO_ 1723 ElmarMPPTB_MaxInputCurrentInput: 8 ElmarMPPTB

BO_ 1724 ElmarMPPTB_Reserved1: 8 ElmarMPPTB

BO_ 1725 ElmarMPPTB_Reserved2: 8 ElmarMPPTB

BO_ 1726 ElmarMPPTB_Reserved3: 8 ElmarMPPTB

BO_ 1727 ElmarMPPTB_Reserved4: 8 ElmarMPPTB

CM_ SG_ 1717 Mode "0 = standby, 1 = local tracking";
CM_ SG_ 1717 TestCounter "+1 every second";
CM_ BO_ 1719 "Only during sweeps, 100Hz send rate";
CM_ SG_ 1720 ModeInput "0 = standby, 1 = local tracking";
SIG_VALTYPE_ 1712 InputVoltage : 1;
SIG_VALTYPE_ 1712 InputCurrent : 1;
SIG_VALTYPE_ 1713 OutputVoltae : 1;
SIG_VALTYPE_ 1713 OutputCurrent : 1;
SIG_VALTYPE_ 1714 MosfetTemperature : 1;
SIG_VALTYPE_ 1714 ControllerTemperature : 1;
SIG_VALTYPE_ 1715 Pwr12V : 1;
SIG_VALTYPE_ 1715 Pwr3V : 1;
SIG_VALTYPE_ 1716 MaxOutputVoltage : 1;
SIG_VALTYPE_ 1716 MaxInputCurrent : 1;
SIG_VALTYPE_ 1718 OutputVoltage : 1;
SIG_VALTYPE_ 1718 PowerConnectorTemperature : 1;
SIG_VALTYPE_ 1719 InputVoltageSweep : 1;
SIG_VALTYPE_ 1719 InputCurrentSweep : 1;
SIG_VALTYPE_ 1722 MaxOutputVoltageInput : 1;
